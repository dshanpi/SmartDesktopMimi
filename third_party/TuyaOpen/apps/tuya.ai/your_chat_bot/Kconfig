## third_party/TuyaOpen/apps/tuya.ai/your_chat_bot/Kconfig
```kconfig
menu "configure app (your_chat_bot) "

config TUYA_PRODUCT_ID
    string "product ID of project"
    default "alon7qgyjj8yus74"

config ENABLE_BATTERY
    bool "enable the battery module"
    default n

config APP_NEED_AI_COMPONENTS
    bool
    default y
    select ENABLE_AI_COMPONENTS
rsource "src/display2/Kconfig"

endmenu
```
